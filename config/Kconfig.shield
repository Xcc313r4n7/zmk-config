## config/Kconfig.shield
```kconfig
config SHIELD_CORNE_LEFT
	def_bool $(shields_list_contains,corne_left)

config SHIELD_CORNE_RIGHT
	def_bool $(shields_list_contains,corne_right)
```

## config/west.yml
```yaml
manifest:
  remotes:
    - name: zmkfirmware
      url-base: https://github.com/zmkfirmware
    - name: m165437 #custom widget for nice view
      url-base: https://github.com/M165437 #custom widget for nice view
    - name: dnaq #plover HID
      url-base: https://github.com/dnaq #plover HID
    # Additional modules containing boards/shields/custom code can be listed here as well
    # See https://docs.zephyrproject.org/3.2.0/develop/west/manifest.html#projects
  projects:
    - name: zmk
      remote: dnaq #default zmkfirmware
      revision: plover-hid-hog-attempt #default main
      import: app/west.yml
    - name: nice-view-gem #custom widget for nice view
      remote: m165437 #custom widget for nice view
      revision: main #custom widget for nice view
  self:
    path: config
```
